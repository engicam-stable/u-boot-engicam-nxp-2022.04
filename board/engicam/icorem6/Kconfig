## board/engicam/icorem6/Kconfig
```kconfig
if TARGET_ICOREM6

config SYS_BOARD
	default "icorem6"

config SYS_VENDOR
	default "engicam"

config SYS_SOC
	default "mx6"

config SYS_CONFIG_NAME
	default "icorem6"

config IMX_CONFIG
	default "board/engicam/icorem6/icorem6dl.cfg"

endif
```

## board/engicam/imx8mp_icore/Kconfig
```kconfig
if TARGET_IMX8MP_ICORE

config SYS_BOARD
	default "imx8mp_icore"

config SYS_VENDOR
	default "engicam"

config SYS_CONFIG_NAME
	default "imx8mp_icore"

config IMX_CONFIG
	default "board/freescale/imx8mp_evk/imximage-8mp-lpddr4.cfg"

source "board/freescale/common/Kconfig"

endif
```

## board/engicam/imx8ulp_microgea/Kconfig
```kconfig
if TARGET_IMX8ULP_MICROGEA

config SYS_BOARD
	default "imx8ulp_microgea"

config SYS_VENDOR
	default "engicam"

config SYS_CONFIG_NAME
	default "imx8ulp_microgea"

source "board/freescale/common/Kconfig"

endif
```

## board/engicam/imx93_icore/Kconfig
```kconfig
if TARGET_IMX93_ICORE

config SYS_BOARD
	default "imx93_icore"

config SYS_VENDOR
	default "engicam"

config SYS_CONFIG_NAME
	default "imx93_icore"

config IMX93_ICORE
	bool "Using LPDDR4X Timing and PMIC voltage"
	default y
	select IMX9_LPDDR4X
	help
	  Select the LPDDR4X timing and 0.6V VDDQ

source "board/freescale/common/Kconfig"

endif
```

## board/engicam/microgea-mx6ull/Kconfig
```kconfig
if TARGET_MICROGEA_MX6ULL

config SYS_BOARD
        default "microgea-mx6ull"

config SYS_VENDOR
        default "engicam"

config SYS_CONFIG_NAME
        default "microgea-mx6ull"

config SYS_SOC
        default "mx6"

config SYS_TEXT_BASE
        default 0x87800000

endif
```

## board/engicam/mx6sxicore/Kconfig
```kconfig
if TARGET_MX6SXICORE

config SYS_BOARD
	default "mx6sxicore"

config SYS_VENDOR
	default "engicam"

config SYS_CONFIG_NAME
	default "mx6sxicore"

config IMX_CONFIG
	default "board/engicam/mx6sxicore/imximage.cfg"

config SYS_TEXT_BASE
	default 0x87800000
endif
```

## board/engicam/mx6sxsmarcore/Kconfig
```kconfig
if TARGET_MX6SXSMARCORE

config SYS_BOARD
	default "mx6sxsmarcore"

config SYS_VENDOR
	default "engicam"

config SYS_CONFIG_NAME
	default "mx6sxsmarcore"

config IMX_CONFIG
	default "board/engicam/mx6sxsmarcore/imximage.cfg"

config MX6SXSABRESD_EMMC_REWORK
	bool "Select for the board with eMMC rework"

config SYS_TEXT_BASE
	default 0x87800000
endif
```

## configs/imx6dl_icore_edimm2_emmc_defconfig
```kconfig
CONFIG_ARM=y
CONFIG_SYS_ICACHE_OFF=y
CONFIG_SYS_DCACHE_OFF=y
CONFIG_ARCH_MX6=y
CONFIG_SYS_TEXT_BASE=0x17800000
CONFIG_SYS_MALLOC_LEN=0x1000000
CONFIG_ENV_SIZE=0x20000
CONFIG_ENV_OFFSET=0x400000
CONFIG_MX6DL=y
CONFIG_TARGET_ICOREM6=y
CONFIG_SYS_EXTRA_OPTIONS="SYS_BOOT_EMMC"
CONFIG_SYS_I2C_MXC_I2C1=y
CONFIG_SYS_I2C_MXC_I2C2=y
CONFIG_SYS_I2C_MXC_I2C3=y
CONFIG_DM_GPIO=y
CONFIG_DEFAULT_DEVICE_TREE="imx6dl-icore-edimm-2.0"
CONFIG_BOOTDELAY=1
CONFIG_DEFAULT_FDT_FILE="imx6dl-icore-emmc-edimm-v2.dtb"
CONFIG_SYS_CONSOLE_OVERWRITE_ROUTINE=y
CONFIG_BOARD_EARLY_INIT_F=y
CONFIG_BOARD_LATE_INIT=y
CONFIG_HUSH_PARSER=y
CONFIG_CMD_BOOTZ=y
CONFIG_CMD_MD5SUM=y
CONFIG_CMD_MEMTEST=y
# CONFIG_CMD_FLASH is not set
CONFIG_CMD_GPIO=y
CONFIG_CMD_I2C=y
CONFIG_CMD_MMC=y
CONFIG_CMD_USB=y
CONFIG_CMD_DHCP=y
CONFIG_CMD_MII=y
CONFIG_CMD_PING=y
CONFIG_CMD_CACHE=y
CONFIG_CMD_EXT2=y
CONFIG_CMD_EXT4=y
CONFIG_CMD_EXT4_WRITE=y
CONFIG_CMD_FAT=y
CONFIG_CMD_FS_GENERIC=y
CONFIG_CMD_UBI=y
CONFIG_OF_CONTROL=y
CONFIG_ENV_IS_IN_MMC=y
CONFIG_L2X0_CACHE=y
CONFIG_SYS_I2C_LEGACY=y
CONFIG_SYS_I2C_MXC=y
CONFIG_FSL_USDHC=y
CONFIG_MTD=y
CONFIG_DM_MTD=y
CONFIG_MTD_RAW_NAND=y
CONFIG_DM_ETH=y
CONFIG_DM_ETH_PHY=y
CONFIG_FEC_MXC=y
CONFIG_DM_SERIAL=y
CONFIG_MXC_UART=y
CONFIG_USB=y
CONFIG_DM_VIDEO=y
CONFIG_VIDEO_IPUV3=y
CONFIG_SPLASH_SCREEN=y
CONFIG_SPLASH_SCREEN_ALIGN=y
CONFIG_VIDEO_BMP_RLE8=y
CONFIG_BMP_16BPP=y
```
